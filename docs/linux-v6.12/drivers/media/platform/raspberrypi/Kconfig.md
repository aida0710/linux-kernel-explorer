## docs/linux-v6.12/drivers/media/platform/raspberrypi/Kconfig.md
~~~~kconfig
---
sidebar_position: 1
---
# Kconfig

### ファイル情報

- パス: `linux-v6.12/drivers/media/platform/raspberrypi/Kconfig`

### コンテンツ

```txt
# SPDX-License-Identifier: GPL-2.0-only

comment "Raspberry Pi media platform drivers"

source "drivers/media/platform/raspberrypi/pisp_be/Kconfig"

```
~~~~

## docs/linux-v6.12/drivers/media/platform/rockchip/Kconfig.md
~~~~kconfig
---
sidebar_position: 1
---
# Kconfig

### ファイル情報

- パス: `linux-v6.12/drivers/media/platform/rockchip/Kconfig`

### コンテンツ

```txt
# SPDX-License-Identifier: GPL-2.0-only

comment "Rockchip media platform drivers"

source "drivers/media/platform/rockchip/rga/Kconfig"
source "drivers/media/platform/rockchip/rkisp1/Kconfig"

```
~~~~

## docs/linux-v6.12/drivers/media/platform/samsung/Kconfig.md
~~~~kconfig
---
sidebar_position: 1
---
# Kconfig

### ファイル情報

- パス: `linux-v6.12/drivers/media/platform/samsung/Kconfig`

### コンテンツ

```txt
# SPDX-License-Identifier: GPL-2.0-only

comment "Samsung media platform drivers"

source "drivers/media/platform/samsung/exynos-gsc/Kconfig"
source "drivers/media/platform/samsung/exynos4-is/Kconfig"
source "drivers/media/platform/samsung/s3c-camif/Kconfig"
source "drivers/media/platform/samsung/s5p-g2d/Kconfig"
source "drivers/media/platform/samsung/s5p-jpeg/Kconfig"
source "drivers/media/platform/samsung/s5p-mfc/Kconfig"

```
~~~~

## docs/linux-v6.12/drivers/media/platform/st/Kconfig.md
~~~~kconfig
---
sidebar_position: 1
---
# Kconfig

### ファイル情報

- パス: `linux-v6.12/drivers/media/platform/st/Kconfig`

### コンテンツ

```txt
# SPDX-License-Identifier: GPL-2.0-only

comment "STMicroelectronics media platform drivers"

source "drivers/media/platform/st/sti/Kconfig"
source "drivers/media/platform/st/stm32/Kconfig"

```
~~~~

## docs/linux-v6.12/drivers/media/platform/st/sti/Kconfig.md
~~~~kconfig
---
sidebar_position: 1
---
# Kconfig

### ファイル情報

- パス: `linux-v6.12/drivers/media/platform/st/sti/Kconfig`

### コンテンツ

```txt
# SPDX-License-Identifier: GPL-2.0-only
source "drivers/media/platform/st/sti/bdisp/Kconfig"
source "drivers/media/platform/st/sti/c8sectpfe/Kconfig"
source "drivers/media/platform/st/sti/delta/Kconfig"
source "drivers/media/platform/st/sti/hva/Kconfig"

```
~~~~

## docs/linux-v6.12/drivers/media/platform/sunxi/Kconfig.md
~~~~kconfig
---
sidebar_position: 1
---
# Kconfig

### ファイル情報

- パス: `linux-v6.12/drivers/media/platform/sunxi/Kconfig`

### コンテンツ

```txt
# SPDX-License-Identifier: GPL-2.0

comment "Sunxi media platform drivers"

source "drivers/media/platform/sunxi/sun4i-csi/Kconfig"
source "drivers/media/platform/sunxi/sun6i-csi/Kconfig"
source "drivers/media/platform/sunxi/sun6i-mipi-csi2/Kconfig"
source "drivers/media/platform/sunxi/sun8i-a83t-mipi-csi2/Kconfig"
source "drivers/media/platform/sunxi/sun8i-di/Kconfig"
source "drivers/media/platform/sunxi/sun8i-rotate/Kconfig"

```
~~~~

## docs/linux-v6.12/drivers/ntb/hw/Kconfig.md
~~~~kconfig
---
sidebar_position: 1
---
# Kconfig

### ファイル情報

- パス: `linux-v6.12/drivers/ntb/hw/Kconfig`

### コンテンツ

```txt
# SPDX-License-Identifier: GPL-2.0-only
source "drivers/ntb/hw/amd/Kconfig"
source "drivers/ntb/hw/idt/Kconfig"
source "drivers/ntb/hw/intel/Kconfig"
source "drivers/ntb/hw/epf/Kconfig"
source "drivers/ntb/hw/mscc/Kconfig"

```
~~~~

## docs/linux-v6.12/drivers/power/Kconfig.md
~~~~kconfig
---
sidebar_position: 1
---
# Kconfig

### ファイル情報

- パス: `linux-v6.12/drivers/power/Kconfig`

### コンテンツ

```txt
# SPDX-License-Identifier: GPL-2.0-only
source "drivers/power/reset/Kconfig"
source "drivers/power/sequencing/Kconfig"
source "drivers/power/supply/Kconfig"

```
~~~~

## docs/linux-v6.12/drivers/scsi/cxgbi/Kconfig.md
~~~~kconfig
---
sidebar_position: 1
---
# Kconfig

### ファイル情報

- パス: `linux-v6.12/drivers/scsi/cxgbi/Kconfig`

### コンテンツ

```txt
# SPDX-License-Identifier: GPL-2.0-only
source "drivers/scsi/cxgbi/cxgb3i/Kconfig"
source "drivers/scsi/cxgbi/cxgb4i/Kconfig"

```
~~~~

## docs/linux-v6.12/drivers/sh/Kconfig.md
~~~~kconfig
---
sidebar_position: 1
---
# Kconfig

### ファイル情報

- パス: `linux-v6.12/drivers/sh/Kconfig`

### コンテンツ

```txt
# SPDX-License-Identifier: GPL-2.0-only
menu "SuperH / SH-Mobile Driver Options"

source "drivers/sh/intc/Kconfig"

endmenu

```
~~~~

## docs/linux-v6.12/drivers/soc/pxa/Kconfig.md
~~~~kconfig
---
sidebar_position: 1
---
# Kconfig

### ファイル情報

- パス: `linux-v6.12/drivers/soc/pxa/Kconfig`

### コンテンツ

```txt
# SPDX-License-Identifier: GPL-2.0-only
config PLAT_PXA
	bool

config PXA_SSP
	tristate
	help
	  Enable support for PXA2xx SSP ports

```
~~~~

## docs/linux-v6.12/drivers/staging/media/starfive/Kconfig.md
~~~~kconfig
---
sidebar_position: 1
---
# Kconfig

### ファイル情報

- パス: `linux-v6.12/drivers/staging/media/starfive/Kconfig`

### コンテンツ

```txt
# SPDX-License-Identifier: GPL-2.0-only

comment "StarFive media platform drivers"

source "drivers/staging/media/starfive/camss/Kconfig"

```
~~~~

## docs/linux-v6.12/drivers/vfio/mdev/Kconfig.md
~~~~kconfig
---
sidebar_position: 1
---
# Kconfig

### ファイル情報

- パス: `linux-v6.12/drivers/vfio/mdev/Kconfig`

### コンテンツ

```txt
# SPDX-License-Identifier: GPL-2.0-only

config VFIO_MDEV
	tristate

```
~~~~

## docs/linux-v6.12/fs/kernfs/Kconfig.md
~~~~kconfig
---
sidebar_position: 4
---
# Kconfig

### ファイル情報

- パス: `linux-v6.12/fs/kernfs/Kconfig`

### コンテンツ

```txt
# SPDX-License-Identifier: GPL-2.0-only
#
# KERNFS should be selected by its users
#

config KERNFS
	bool
	default n

```
~~~~

## docs/linux-v6.12/scripts/kconfig/tests/err_recursive_inc/Kconfig.inc1.md
~~~~kconfig
---
sidebar_position: 3
---
# Kconfig.inc1

### ファイル情報

- パス: `linux-v6.12/scripts/kconfig/tests/err_recursive_inc/Kconfig.inc1`

### コンテンツ

```inc1
# SPDX-License-Identifier: GPL-2.0-only



source "Kconfig.inc2"

```
~~~~

## docs/linux-v6.12/scripts/kconfig/tests/err_recursive_inc/Kconfig.inc2.md
~~~~kconfig
---
sidebar_position: 4
---
# Kconfig.inc2

### ファイル情報

- パス: `linux-v6.12/scripts/kconfig/tests/err_recursive_inc/Kconfig.inc2`

### コンテンツ

```inc2
# SPDX-License-Identifier: GPL-2.0-only


source "Kconfig.inc3"

```
~~~~

## docs/linux-v6.12/scripts/kconfig/tests/err_recursive_inc/Kconfig.inc3.md
~~~~kconfig
---
sidebar_position: 5
---
# Kconfig.inc3

### ファイル情報

- パス: `linux-v6.12/scripts/kconfig/tests/err_recursive_inc/Kconfig.inc3`

### コンテンツ

```inc3
# SPDX-License-Identifier: GPL-2.0-only
source "Kconfig.inc1"

```
~~~~

## docs/linux-v6.12/scripts/kconfig/tests/err_recursive_inc/Kconfig.md
~~~~kconfig
---
sidebar_position: 2
---
# Kconfig

### ファイル情報

- パス: `linux-v6.12/scripts/kconfig/tests/err_recursive_inc/Kconfig`

### コンテンツ

```txt
# SPDX-License-Identifier: GPL-2.0-only
source "Kconfig.inc1"

```
~~~~

## docs/linux-v6.12/sound/soc/google/Kconfig.md
~~~~kconfig
---
sidebar_position: 2
---
# Kconfig

### ファイル情報

- パス: `linux-v6.12/sound/soc/google/Kconfig`

### コンテンツ

```txt
# SPDX-License-Identifier: GPL-2.0-only

config SND_SOC_CHV3_I2S
	tristate "Google Chameleon v3 I2S device"
	help
	  Enable support for the Google Chameleon v3 I2S device.

```
~~~~

## docs/linux-v6.12/sound/soc/sof/xtensa/Kconfig.md
~~~~kconfig
---
sidebar_position: 2
---
# Kconfig

### ファイル情報

- パス: `linux-v6.12/sound/soc/sof/xtensa/Kconfig`

### コンテンツ

```txt
# SPDX-License-Identifier: GPL-2.0-only
config SND_SOC_SOF_XTENSA
	tristate

```
~~~~

## docs/linux-v6.12/sound/synth/Kconfig.md
~~~~kconfig
---
sidebar_position: 1
---
# Kconfig

### ファイル情報

- パス: `linux-v6.12/sound/synth/Kconfig`

### コンテンツ

```txt
# SPDX-License-Identifier: GPL-2.0-only
config SND_SYNTH_EMUX
	tristate

```
~~~~

## docs/linux-v6.12/virt/lib/Kconfig.md
~~~~kconfig
---
sidebar_position: 2
---
# Kconfig

### ファイル情報

- パス: `linux-v6.12/virt/lib/Kconfig`

### コンテンツ

```txt
# SPDX-License-Identifier: GPL-2.0-only
config IRQ_BYPASS_MANAGER
	tristate

```
~~~~

## docs/net/strparser/Kconfig.md
~~~~kconfig
---
sidebar_position: 1
---
# Kconfig

### ファイル情報

- パス: `net/strparser/Kconfig`

### コンテンツ

```txt
# SPDX-License-Identifier: GPL-2.0-only
config STREAM_PARSER
	def_bool n

```
~~~~
