## docs/drivers/net/ethernet/apm/Kconfig.md
~~~~kconfig
---
sidebar_position: 1
---
# Kconfig

### ファイル情報

- パス: `drivers/net/ethernet/apm/Kconfig`

### コンテンツ

```txt
# SPDX-License-Identifier: GPL-2.0-only
source "drivers/net/ethernet/apm/xgene/Kconfig"
source "drivers/net/ethernet/apm/xgene-v2/Kconfig"

```
~~~~

## docs/linux-v6.12/arch/riscv/Kconfig.debug.md
~~~~kconfig
---
sidebar_position: 3
---
# Kconfig.debug

### ファイル情報

- パス: `linux-v6.12/arch/riscv/Kconfig.debug`

### コンテンツ

```debug
source "arch/riscv/kernel/tests/Kconfig.debug"

```
~~~~

## docs/linux-v6.12/drivers/bus/mhi/Kconfig.md
~~~~kconfig
---
sidebar_position: 2
---
# Kconfig

### ファイル情報

- パス: `linux-v6.12/drivers/bus/mhi/Kconfig`

### コンテンツ

```txt
# SPDX-License-Identifier: GPL-2.0
#
# MHI bus
#
# Copyright (c) 2021, Linaro Ltd.
#

source "drivers/bus/mhi/host/Kconfig"
source "drivers/bus/mhi/ep/Kconfig"

```
~~~~

## docs/linux-v6.12/drivers/clk/analogbits/Kconfig.md
~~~~kconfig
---
sidebar_position: 1
---
# Kconfig

### ファイル情報

- パス: `linux-v6.12/drivers/clk/analogbits/Kconfig`

### コンテンツ

```txt
# SPDX-License-Identifier: GPL-2.0-only
config CLK_ANALOGBITS_WRPLL_CLN28HPC
	tristate

```
~~~~

## docs/linux-v6.12/drivers/crypto/intel/Kconfig.md
~~~~kconfig
---
sidebar_position: 1
---
# Kconfig

### ファイル情報

- パス: `linux-v6.12/drivers/crypto/intel/Kconfig`

### コンテンツ

```txt
# SPDX-License-Identifier: GPL-2.0

source "drivers/crypto/intel/keembay/Kconfig"
source "drivers/crypto/intel/ixp4xx/Kconfig"
source "drivers/crypto/intel/qat/Kconfig"
source "drivers/crypto/intel/iaa/Kconfig"

```
~~~~

## docs/linux-v6.12/drivers/dca/Kconfig.md
~~~~kconfig
---
sidebar_position: 3
---
# Kconfig

### ファイル情報

- パス: `linux-v6.12/drivers/dca/Kconfig`

### コンテンツ

```txt
# SPDX-License-Identifier: GPL-2.0-only
#
# DCA server configuration
#

config DCA
	tristate


```
~~~~

## docs/linux-v6.12/drivers/dpll/Kconfig.md
~~~~kconfig
---
sidebar_position: 7
---
# Kconfig

### ファイル情報

- パス: `linux-v6.12/drivers/dpll/Kconfig`

### コンテンツ

```txt
# SPDX-License-Identifier: GPL-2.0-only
#
# Generic DPLL drivers configuration
#

config DPLL
	bool

```
~~~~

## docs/linux-v6.12/drivers/firmware/cirrus/Kconfig.md
~~~~kconfig
---
sidebar_position: 2
---
# Kconfig

### ファイル情報

- パス: `linux-v6.12/drivers/firmware/cirrus/Kconfig`

### コンテンツ

```txt
# SPDX-License-Identifier: GPL-2.0-only

config FW_CS_DSP
	tristate
	default n

```
~~~~

## docs/linux-v6.12/drivers/gpu/drm/hisilicon/Kconfig.md
~~~~kconfig
---
sidebar_position: 1
---
# Kconfig

### ファイル情報

- パス: `linux-v6.12/drivers/gpu/drm/hisilicon/Kconfig`

### コンテンツ

```txt
# SPDX-License-Identifier: GPL-2.0-only
#
# hisilicon drm device configuration.
# Please keep this list sorted alphabetically

source "drivers/gpu/drm/hisilicon/hibmc/Kconfig"
source "drivers/gpu/drm/hisilicon/kirin/Kconfig"

```
~~~~

## docs/linux-v6.12/drivers/gpu/drm/imx/Kconfig.md
~~~~kconfig
---
sidebar_position: 1
---
# Kconfig

### ファイル情報

- パス: `linux-v6.12/drivers/gpu/drm/imx/Kconfig`

### コンテンツ

```txt
# SPDX-License-Identifier: GPL-2.0-only

source "drivers/gpu/drm/imx/dcss/Kconfig"
source "drivers/gpu/drm/imx/ipuv3/Kconfig"
source "drivers/gpu/drm/imx/lcdc/Kconfig"

```
~~~~

## docs/linux-v6.12/drivers/gpu/drm/renesas/Kconfig.md
~~~~kconfig
---
sidebar_position: 1
---
# Kconfig

### ファイル情報

- パス: `linux-v6.12/drivers/gpu/drm/renesas/Kconfig`

### コンテンツ

```txt
# SPDX-License-Identifier: GPL-2.0-only

source "drivers/gpu/drm/renesas/rcar-du/Kconfig"
source "drivers/gpu/drm/renesas/rz-du/Kconfig"
source "drivers/gpu/drm/renesas/shmobile/Kconfig"

```
~~~~

## docs/linux-v6.12/drivers/gpu/trace/Kconfig.md
~~~~kconfig
---
sidebar_position: 1
---
# Kconfig

### ファイル情報

- パス: `linux-v6.12/drivers/gpu/trace/Kconfig`

### コンテンツ

```txt
# SPDX-License-Identifier: GPL-2.0-only

config TRACE_GPU_MEM
	bool

```
~~~~

## docs/linux-v6.12/drivers/iio/common/Kconfig.md
~~~~kconfig
---
sidebar_position: 1
---
# Kconfig

### ファイル情報

- パス: `linux-v6.12/drivers/iio/common/Kconfig`

### コンテンツ

```txt
# SPDX-License-Identifier: GPL-2.0-only
#
# IIO common modules
#

source "drivers/iio/common/cros_ec_sensors/Kconfig"
source "drivers/iio/common/hid-sensors/Kconfig"
source "drivers/iio/common/inv_sensors/Kconfig"
source "drivers/iio/common/ms_sensors/Kconfig"
source "drivers/iio/common/scmi_sensors/Kconfig"
source "drivers/iio/common/ssp_sensors/Kconfig"
source "drivers/iio/common/st_sensors/Kconfig"

```
~~~~

## docs/linux-v6.12/drivers/iio/common/inv_sensors/Kconfig.md
~~~~kconfig
---
sidebar_position: 2
---
# Kconfig

### ファイル情報

- パス: `linux-v6.12/drivers/iio/common/inv_sensors/Kconfig`

### コンテンツ

```txt
# SPDX-License-Identifier: GPL-2.0-only
#
# TDK-InvenSense sensors common library
#

config IIO_INV_SENSORS_TIMESTAMP
	tristate

```
~~~~

## docs/linux-v6.12/drivers/iio/common/ms_sensors/Kconfig.md
~~~~kconfig
---
sidebar_position: 1
---
# Kconfig

### ファイル情報

- パス: `linux-v6.12/drivers/iio/common/ms_sensors/Kconfig`

### コンテンツ

```txt
# SPDX-License-Identifier: GPL-2.0-only
#
# Measurements Specialties sensors common library
#

config IIO_MS_SENSORS_I2C
	tristate

```
~~~~

## docs/linux-v6.12/drivers/media/common/v4l2-tpg/Kconfig.md
~~~~kconfig
---
sidebar_position: 1
---
# Kconfig

### ファイル情報

- パス: `linux-v6.12/drivers/media/common/v4l2-tpg/Kconfig`

### コンテンツ

```txt
# SPDX-License-Identifier: GPL-2.0-only
config VIDEO_V4L2_TPG
	tristate

```
~~~~

## docs/linux-v6.12/drivers/media/i2c/et8ek8/Kconfig.md
~~~~kconfig
---
sidebar_position: 4
---
# Kconfig

### ファイル情報

- パス: `linux-v6.12/drivers/media/i2c/et8ek8/Kconfig`

### コンテンツ

```txt
# SPDX-License-Identifier: GPL-2.0-only
config VIDEO_ET8EK8
	tristate "ET8EK8 camera sensor support"
	help
	  This is a driver for the Toshiba ET8EK8 5 MP camera sensor.
	  It is used for example in Nokia N900 (RX-51).

```
~~~~

## docs/linux-v6.12/drivers/media/mmc/Kconfig.md
~~~~kconfig
---
sidebar_position: 1
---
# Kconfig

### ファイル情報

- パス: `linux-v6.12/drivers/media/mmc/Kconfig`

### コンテンツ

```txt
# SPDX-License-Identifier: GPL-2.0-only

source "drivers/media/mmc/siano/Kconfig"

```
~~~~

## docs/linux-v6.12/drivers/media/platform/amlogic/Kconfig.md
~~~~kconfig
---
sidebar_position: 1
---
# Kconfig

### ファイル情報

- パス: `linux-v6.12/drivers/media/platform/amlogic/Kconfig`

### コンテンツ

```txt
# SPDX-License-Identifier: GPL-2.0-only

comment "Amlogic media platform drivers"

source "drivers/media/platform/amlogic/meson-ge2d/Kconfig"

```
~~~~

## docs/linux-v6.12/drivers/media/platform/chips-media/Kconfig.md
~~~~kconfig
---
sidebar_position: 1
---
# Kconfig

### ファイル情報

- パス: `linux-v6.12/drivers/media/platform/chips-media/Kconfig`

### コンテンツ

```txt
# SPDX-License-Identifier: GPL-2.0-only

comment "Chips&Media media platform drivers"

source "drivers/media/platform/chips-media/coda/Kconfig"
source "drivers/media/platform/chips-media/wave5/Kconfig"

```
~~~~

## docs/linux-v6.12/drivers/media/platform/mediatek/Kconfig.md
~~~~kconfig
---
sidebar_position: 1
---
# Kconfig

### ファイル情報

- パス: `linux-v6.12/drivers/media/platform/mediatek/Kconfig`

### コンテンツ

```txt
# SPDX-License-Identifier: GPL-2.0-only

comment "Mediatek media platform drivers"

source "drivers/media/platform/mediatek/jpeg/Kconfig"
source "drivers/media/platform/mediatek/mdp/Kconfig"
source "drivers/media/platform/mediatek/vcodec/Kconfig"
source "drivers/media/platform/mediatek/vpu/Kconfig"
source "drivers/media/platform/mediatek/mdp3/Kconfig"

```
~~~~

## docs/linux-v6.12/drivers/media/platform/nvidia/Kconfig.md
~~~~kconfig
---
sidebar_position: 1
---
# Kconfig

### ファイル情報

- パス: `linux-v6.12/drivers/media/platform/nvidia/Kconfig`

### コンテンツ

```txt
# SPDX-License-Identifier: GPL-2.0-only

comment "NVidia media platform drivers"

source "drivers/media/platform/nvidia/tegra-vde/Kconfig"

```
~~~~

## docs/linux-v6.12/drivers/media/platform/qcom/Kconfig.md
~~~~kconfig
---
sidebar_position: 1
---
# Kconfig

### ファイル情報

- パス: `linux-v6.12/drivers/media/platform/qcom/Kconfig`

### コンテンツ

```txt
# SPDX-License-Identifier: GPL-2.0-only

comment "Qualcomm media platform drivers"

source "drivers/media/platform/qcom/camss/Kconfig"
source "drivers/media/platform/qcom/venus/Kconfig"

```
~~~~
